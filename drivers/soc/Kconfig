## drivers/soc/Kconfig
```kconfig
# SPDX-License-Identifier: GPL-2.0-only
menu "SOC (System On Chip) specific Drivers"

source "drivers/soc/actions/Kconfig"
source "drivers/soc/amlogic/Kconfig"
source "drivers/soc/apple/Kconfig"
source "drivers/soc/aspeed/Kconfig"
source "drivers/soc/atmel/Kconfig"
source "drivers/soc/bcm/Kconfig"
source "drivers/soc/canaan/Kconfig"
source "drivers/soc/fsl/Kconfig"
source "drivers/soc/fujitsu/Kconfig"
source "drivers/soc/imx/Kconfig"
source "drivers/soc/ixp4xx/Kconfig"
source "drivers/soc/litex/Kconfig"
source "drivers/soc/mediatek/Kconfig"
source "drivers/soc/microchip/Kconfig"
source "drivers/soc/pxa/Kconfig"
source "drivers/soc/qcom/Kconfig"
source "drivers/soc/renesas/Kconfig"
source "drivers/soc/rockchip/Kconfig"
source "drivers/soc/samsung/Kconfig"
source "drivers/soc/sifive/Kconfig"
source "drivers/soc/sunxi/Kconfig"
source "drivers/soc/tegra/Kconfig"
source "drivers/soc/ti/Kconfig"
source "drivers/soc/ux500/Kconfig"
source "drivers/soc/versatile/Kconfig"
source "drivers/soc/xilinx/Kconfig"

#ifdef OPLUS_FEATURE_MM_FEEDBACK
source "drivers/soc/oplus/multimedia/Kconfig"
#endif /* OPLUS_FEATURE_MM_FEEDBACK */

#ifdef OPLUS_FEATURE_OCH
source "kernel/oplus_cpu/cpufreq_health/Kconfig"
#endif /* OPLUS_FEATURE_OCH */

source "kernel/oplus_cpu/uad/Kconfig"

source "kernel/oplus_cpu/thermal/Kconfig"

#ifdef OPLUS_FEATURE_GAME_OPT
source "kernel/oplus_cpu/game_opt/Kconfig"
#endif /* OPLUS_FEATURE_GAME_OPT */

#ifdef OPLUS_LOCKING_STRATEGY
source "kernel/locking/oplus_locking/Kconfig"
#endif /* OPLUS_LOCKING_STRATEGY */

#ifdef OPLUS_FEATURE_OMRG
source "kernel/oplus_cpu/oplus_omrg/Kconfig"
#endif /* OPLUS_FEATURE_OMRG */

#ifdef OPLUS_FEATURE_GKI_CPUFREQ_BOUNCING
source "kernel/oplus_cpu/cpufreq_bouncing/Kconfig"
#endif /* OPLUS_FEATURE_GKI_CPUFREQ_BOUNCING */

#ifdef OPLUS_FEATURE_ABNORMAL_FLAG
source "kernel/oplus_cpu/oplus_overload/Kconfig"
#endif /* OPLUS_FEATURE_ABNORMAL_FLAG */

#ifdef OPLUS_FEATURE_BOOT
source "drivers/soc/oplus/boot/cmdline_parser/Kconfig"
source "drivers/soc/oplus/boot/bootloader_log/Kconfig"
source "drivers/soc/oplus/boot/oplus_projectinfo/Kconfig"
source "drivers/soc/oplus/boot/bootmode/Kconfig"
source "drivers/soc/oplus/boot/htb/Kconfig"
#endif /* OPLUS_FEATURE_BOOT */

#ifdef OPLUS_FEATURE_PHOENIX
source "drivers/soc/oplus/boot/oplus_phoenix/Kconfig"
#endif

#ifdef OPLUS_FEATURE_MIDAS_GKI
source "drivers/soc/oplus/midas/Kconfig"
#endif

#ifdef OPLUS_FEATURE_QCOM_WATCHDOG
source "drivers/soc/oplus/boot/qcom_watchdog/Kconfig"
#endif

endmenu

#ifdef OPLUS_FEATURE_TP_BASIC
source "drivers/soc/oplus/device_info/Kconfig"
#endif /* OPLUS_FEATURE_TP_BASIC */

#ifdef OPLUS_TRIKEY_MAIN
source "drivers/soc/oplus/tri_state_key/Kconfig"
#endif /* CONFIG_OPLUS_TRIKEY_MAIN */

#ifdef OPLUS_FEATURE_DFT
source "drivers/soc/oplus/dft/Kconfig"
#endif /* OPLUS_FEATURE_DFT */

source "drivers/soc/oplus/dfr/Kconfig"

source "drivers/soc/oplus/storage/Kconfig"

#ifdef OPLUS_FEATURE_WIFI_ROUTERBOOST
source "drivers/soc/oplus/wifi/oplus_connectivity_routerboost/Kconfig"
#endif /* OPLUS_FEATURE_WIFI_ROUTERBOOST */

#ifdef OPLUS_FEATURE_WIFI_SLA
source "drivers/soc/oplus/wifi/oplus_connectivity_sla/Kconfig"
#endif /* OPLUS_FEATURE_WIFI_SLA */

#ifdef OPLUS_FEATURE_WIFI_CAPCENTER
source "drivers/soc/oplus/wifi/oplus_wificapcenter/Kconfig"
#endif /* OPLUS_FEATURE_WIFI_CAPCENTER */

#ifdef OPLUS_FEATURE_WIFI_SMARTANTENNA
source "drivers/soc/oplus/wifi/oplus_wifi_wsa/Kconfig"
#endif /* OPLUS_FEATURE_WIFI_SMARTANTENNA */

#ifdef OPLUS_FEATURE_DATA_MODULE
source "drivers/soc/oplus/network/data_module/Kconfig"
#endif /* OPLUS_FEATURE_DATA_MODULE */

#ifdef OPLUS_FEATURE_LINKPOWER_MODULE
source "drivers/soc/oplus/network/linkpower_module/Kconfig"
#endif /* OPLUS_FEATURE_LINKPOWER_MODULE */

#ifdef OPLUS_FEATURE_APP_MONITOR
source "drivers/soc/oplus/network/oplus_apps_monitor/Kconfig"
#endif /* OPLUS_FEATURE_APP_MONITOR */

#ifdef OPLUS_FEATURE_DNS_HOOK
source "drivers/soc/oplus/network/oplus_dns_hook/Kconfig"
#endif /* OPLUS_FEATURE_DNS_HOOK */

#ifdef OPLUS_FEATURE_GAME_FIRST
source "drivers/soc/oplus/network/oplus_game_first/Kconfig"
#endif /* OPLUS_FEATURE_GAME_FIRST */

#ifdef OPLUS_FEATURE_ESIM
source "drivers/soc/oplus/network/oplus_network_esim/Kconfig"
#endif /* OPLUS_FEATURE_ESIM */

#ifdef OPLUS_FEATURE_OEM_QMI
source "drivers/soc/oplus/network/oplus_network_oem_qmi/Kconfig"
#endif /* OPLUS_FEATURE_OEM_QMI */

#ifdef OPLUS_FEATURE_SIM_DETECT
source "drivers/soc/oplus/network/oplus_network_sim_detect/Kconfig"
#endif /* OPLUS_FEATURE_SIM_DETECT */

#ifdef OPLUS_FEATURE_NETWORK_KERNEL
source "drivers/soc/oplus/network/oplus_network_tuning/Kconfig"
#endif /* OPLUS_FEATURE_NETWORK_KERNEL */

#ifdef OPLUS_FEATURE_QR_SCAN
source "drivers/soc/oplus/network/oplus_qr_scan/Kconfig"
#endif /* OPLUS_FEATURE_QR_SCAN */

#ifdef OPLUS_FEATURE_RF_CABLE_MONITOR
source "drivers/soc/oplus/network/oplus_rf_cable_monitor/Kconfig"
#endif /* OPLUS_FEATURE_RF_CABLE_MONITOR */

#ifdef OPLUS_FEATURE_DATA_EVAL
source "drivers/soc/oplus/network/oplus_score/Kconfig"
#endif /* OPLUS_FEATURE_DATA_EVAL */

#ifdef OPLUS_FEATURE_ESTABLISH_REPORT
source "drivers/soc/oplus/network/oplus_socket_stats_report/Kconfig"
#endif /* OPLUS_FEATURE_ESTABLISH_REPORT */

#ifdef OPLUS_FEATURE_STATS_CALC
source "drivers/soc/oplus/network/oplus_stats_calc/Kconfig"
#endif /* OPLUS_FEATURE_STATS_CALC */

#ifdef OPLUS_FEATURE_VIRTUAL_NET
source "drivers/soc/oplus/network/oplus_vnet/Kconfig"
#endif /* OPLUS_FEATURE_VIRTUAL_NET */

#ifdef OPLUS_FEATURE_HANS
source "drivers/soc/oplus/network/hans/Kconfig"
#endif /* OPLUS_FEATURE_HANS */

#ifdef OPLUS_FEATURE_MDMFEATURE
source "drivers/soc/oplus/radio/mdmfeature/Kconfig"
#endif /* OPLUS_FEATURE_MDMFEATURE */

#ifdef OPLUS_FEATURE_RECORD_MDMRST
source "drivers/soc/oplus/radio/mdmrst/Kconfig"
#endif /* OPLUS_FEATURE_RECORD_MDMRST */

#ifdef OPLUS_SUBSYS_SLEEP_MONITOR
source "drivers/soc/oplus/power/subsys_sleep_monitor/Kconfig"
#endif /* OPLUS_SUBSYS_SLEEP_MONITOR */

source "drivers/soc/oplus/sensors/oplus_consumer_ir/Kconfig"
source "drivers/soc/oplus/sensors/pseudo-sensor/Kconfig"
source "drivers/soc/oplus/sensors/sensor/Kconfig"
```

## drivers/soc/oplus/network/linkpower_module/Kconfig
```kconfig
# SPDX-License-Identifier: GPL-2.0-only
# Copyright (C) 2020-2022 Oplus. All rights reserved.

config OPLUS_FEATURE_LINKPOWER_MODULE
        tristate "Add for linkpower modules"
        help
          Add for linkpower modules.
```

## drivers/soc/oplus/network/oplus_game_first/Kconfig
```kconfig
# SPDX-License-Identifier: GPL-2.0-only
# Copyright (C) 2020-2022 Oplus. All rights reserved.

config OPLUS_FEATURE_GAME_FIRST
        tristate "Add for game first"
        help
          Add for game first modules.
```

## drivers/soc/oplus/network/oplus_network_oem_qmi/Kconfig
```kconfig
# SPDX-License-Identifier: GPL-2.0-only
# Copyright (C) 2020-2022 Oplus. All rights reserved.

config OPLUS_FEATURE_OEM_QMI
        tristate "Add for oem qmi"
        help
          Add for oem qmi modules.
```

## drivers/soc/oplus/network/oplus_network_sim_detect/Kconfig
```kconfig
# SPDX-License-Identifier: GPL-2.0-only
# Copyright (C) 2020-2022 Oplus. All rights reserved.

config OPLUS_FEATURE_SIM_DETECT
        tristate "Add for sim detect"
        help
          Add for sim detect modules.
```

## drivers/soc/oplus/network/oplus_rf_cable_monitor/Kconfig
```kconfig
# SPDX-License-Identifier: GPL-2.0-only
# Copyright (C) 2020-2022 Oplus. All rights reserved.

config OPLUS_FEATURE_RF_CABLE_MONITOR
        tristate "Add for cable monitor"
        help
          Add for cable monitor modules.
```

## drivers/soc/oplus/wifi/oplus_wifi_wsa/Kconfig
```kconfig
# SPDX-License-Identifier: GPL-2.0-only
# Copyright (C) 2020-2022 Oplus. All rights reserved.

config OPLUS_FEATURE_WIFI_SMARTANTENNA
	tristate "Add for oplus wifi smart antenna function"
	default n
	help
	  Add for oplus wifi ant function.
```

## kernel/oplus_cpu/Kconfig
```kconfig
# SPDX-License-Identifier: GPL-2.0-only
# Copyright (C) 2018-2022 Oplus. All rights reserved.

source "$(KCONFIG_EXT_PREFIX)drivers/soc/oplus/cpu/thermal/Kconfig"
source "$(KCONFIG_EXT_PREFIX)drivers/soc/oplus/cpu/oplus_omrg/Kconfig"
source "$(KCONFIG_EXT_PREFIX)drivers/soc/oplus/cpu/oplus_overload/Kconfig"
```

## kernel/oplus_cpu/game_opt/Kconfig
```kconfig
# SPDX-License-Identifier: GPL-2.0-only
#
# OPlus Game Opt
#
config OPLUS_FEATURE_GAME_OPT
	tristate "OPlus game optimization features"
	default n
	help
	  OPlus IPA thermal management
```

## kernel/oplus_cpu/thermal/Kconfig
```kconfig
# SPDX-License-Identifier: GPL-2.0-only
#
# OPlus Thermal
#
config HORAE_THERMAL_SHELL
	tristate "OPlus thermal shell"
	help
	  OPlus horae shell temp, needed for oplus ipa

config OPLUS_IPA_THERMAL
	tristate "OPlus IPA Thermal"
	depends on HORAE_THERMAL_SHELL
	help
	  OPlus IPA thermal management
```

## mm/memleak_detect/Kconfig
```kconfig
config MEMLEAK_DETECT_SIMPLE
        tristate "memleak detect simple"
        help
          Simple OPlus memleak detector
```

## mm/proactive_compact/Kconfig
```kconfig
config OPLUS_PROACTIVE_COMPACT
	tristate "proactive compact"
	default n
	help
	  oplus proactive compact
```

## mm/sigkill_diagnosis/Kconfig
```kconfig
config OPLUS_FEATURE_SIGKILL_DIAGNOSIS
        tristate "sigkill diagnosis"
        help
          OPlus sigkill diagnosis
```
